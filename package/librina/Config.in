## package/librina/Config.in
```kconfig
config BR2_PACKAGE_LIBRINA
        bool "librina"
        select BR2_PACKAGE_FAKELINUXDEP
        select BR2_PACKAGE_PROTOBUF
        help
          The librina package is part of the IRATI stack.

          https://github.com/irati/stack
```

## package/openjdk-bin/Config.in
```kconfig
config BR2_PACKAGE_OPENJDK_BIN
	bool "openjdk (precompiled glibc binaries)"
	depends on BR2_x86_64
	help
	  Precompiled openjdk runtime based on the openjdk debian packages.
```
